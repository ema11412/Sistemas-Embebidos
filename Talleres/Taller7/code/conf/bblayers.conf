## Talleres/Taller7/code/conf/bblayers.conf
```bitbake
# POKY_BBLAYERS_CONF_VERSION is increased each time build/conf/bblayers.conf
# changes incompatibly
POKY_BBLAYERS_CONF_VERSION = "2"

BBPATH = "${TOPDIR}"
BBFILES ?= ""

BBLAYERS ?= " \
  /home/elda/dev/tec/2021/arqui2/poky/meta \
  /home/elda/dev/tec/2021/arqui2/poky/meta-poky \
  /home/elda/dev/tec/2021/arqui2/poky/meta-yocto-bsp \
  /home/elda/dev/tec/2021/arqui2/poky/meta-raspberrypi \
  "
```
